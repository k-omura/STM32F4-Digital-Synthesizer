/*
 * FSMC_ILI9341.h
 *
 *  Created on: Dec 8, 2021
 *      Author: k-omura
 *
 * FSMC 8bit
 */


//Header files
#include <FSMC_ILI9341.h>

static uint8_t rotationNum = 1;

//***** Functions *****//
void ILI9341_sendCommand16(uint16_t _cmd) {
	*(volatile uint16_t*) LCD_ADDR_BASE = _cmd;
}

void ILI9341_sendData16(uint16_t _data) {
	*(volatile uint16_t*) LCD_ADDR_DATA = _data;
}

void ILI9341_sendCommand8(uint8_t _cmd) {
	*(volatile uint16_t*) LCD_ADDR_BASE = (uint16_t) _cmd;
}

void ILI9341_sendData8(uint8_t _data) {
	*(volatile uint16_t*) LCD_ADDR_DATA = (uint16_t) _data;
}

void ILI9341_init(void) {
	ILI9341_sendCommand8(ILI9341_RESET); // software reset command
	HAL_Delay(100);
	ILI9341_sendCommand8(ILI9341_DISPLAY_OFF); // display off
	//------------power control------------------------------
	ILI9341_sendCommand8(ILI9341_POWER1); // power control
	ILI9341_sendData8(0x26); // GVDD = 4.75v
	ILI9341_sendCommand8(ILI9341_POWER2); // power control
	ILI9341_sendData8(0x11); // AVDD=VCIx2, VGH=VCIx7, VGL=-VCIx3
	//--------------VCOM-------------------------------------
	ILI9341_sendCommand8(ILI9341_VCOM1); // vcom control
	ILI9341_sendData8(0x35); // Set the VCOMH voltage (0x35 = 4.025v)
	ILI9341_sendData8(0x3e); // Set the VCOML voltage (0x3E = -0.950v)
	ILI9341_sendCommand8(ILI9341_VCOM2); // vcom control
	ILI9341_sendData8(0xbe);

	//------------memory access control------------------------
	ILI9341_sendCommand8(ILI9341_MAC); // memory access control
	ILI9341_sendData8(0x48);

	ILI9341_sendCommand8(ILI9341_PIXEL_FORMAT); // pixel format set
	ILI9341_sendData8(0x55); // 16bit/pixel 16bitColor

	ILI9341_sendCommand8(ILI9341_FRC);
	ILI9341_sendData8(0);
	ILI9341_sendData8(0x1F);
	//-------------ddram ----------------------------
	ILI9341_sendCommand8(ILI9341_COLUMN_ADDR); // column set
	ILI9341_sendData8(0x00); // x0_HIGH---0
	ILI9341_sendData8(0x00); // x0_LOW----0
	ILI9341_sendData8(0x00); // x1_HIGH---240
	ILI9341_sendData8(0xEF); // x1_LOW----240
	ILI9341_sendCommand8(ILI9341_PAGE_ADDR); // page address set
	ILI9341_sendData8(0x00); // y0_HIGH---0
	ILI9341_sendData8(0x00); // y0_LOW----0
	ILI9341_sendData8(0x01); // y1_HIGH---320
	ILI9341_sendData8(0x3F); // y1_LOW----320

	ILI9341_sendCommand8(ILI9341_TEARING_OFF); // tearing effect off
	//LCD_write_cmd(ILI9341_TEARING_ON); // tearing effect on
	//LCD_write_cmd(ILI9341_DISPLAY_INVERSION); // display inversion
	ILI9341_sendCommand8(ILI9341_Entry_Mode_Set); // entry mode set
	// Deep Standby Mode: OFF
	// Set the output level of gate driver G1-G320: Normal display
	// Low voltage detection: Disable
	ILI9341_sendData8(0x07);
	//-----------------display------------------------
	ILI9341_sendCommand8(ILI9341_DFC); // display function control
	//Set the scan mode in non-display area
	//Determine source/VCOM output in a non-display area in the partial display mode
	ILI9341_sendData8(0x0a);
	//Select whether the liquid crystal type is normally white type or normally black type
	//Sets the direction of scan by the gate driver in the range determined by SCN and NL
	//Select the shift direction of outputs from the source driver
	//Sets the gate driver pin arrangement in combination with the GS bit to select the optimal scan mode for the module
	//Specify the scan cycle interval of gate driver in non-display area when PTG to select interval scan
	ILI9341_sendData8(0x82);
	// Sets the number of lines to drive the LCD at an interval of 8 lines
	ILI9341_sendData8(0x27);
	ILI9341_sendData8(0x00); // clock divisor

	ILI9341_sendCommand8(ILI9341_SLEEP_OUT); // sleep out
	HAL_Delay(100);
	ILI9341_sendCommand8(ILI9341_DISPLAY_ON); // display on
	HAL_Delay(100);
	ILI9341_sendCommand8(ILI9341_GRAM); // memory write
	HAL_Delay(5);
}

void ILI9341_setRotation(uint8_t _rotate) {
	switch (_rotate) {
	case 1:
		rotationNum = 1;
		ILI9341_sendCommand8(ILI9341_MEMCONTROL);
		ILI9341_sendData8(ILI9341_MADCTL_MY | ILI9341_MADCTL_BGR);
		break;
	case 2:
		rotationNum = 2;
		ILI9341_sendCommand8(ILI9341_MEMCONTROL);
		ILI9341_sendData8(ILI9341_MADCTL_MV | ILI9341_MADCTL_BGR);
		break;
	case 3:
		rotationNum = 3;
		ILI9341_sendCommand8(ILI9341_MEMCONTROL);
		ILI9341_sendData8(ILI9341_MADCTL_MX | ILI9341_MADCTL_BGR);
		break;
	case 4:
		rotationNum = 4;
		ILI9341_sendCommand8(ILI9341_MEMCONTROL);
		ILI9341_sendData8(
				ILI9341_MADCTL_MX | ILI9341_MADCTL_MY | ILI9341_MADCTL_MV
						| ILI9341_MADCTL_BGR);
		break;
	default:
		rotationNum = 1;
		ILI9341_sendCommand8(ILI9341_MEMCONTROL);
		ILI9341_sendData8(ILI9341_MADCTL_MY | ILI9341_MADCTL_BGR);
		break;
	}
}

void ILI9341_setRect(uint16_t _x1, uint16_t _y1, uint16_t _x2, uint16_t _y2) {
	ILI9341_sendCommand8(ILI9341_COLUMN_ADDR);
	ILI9341_sendData8(_x1 >> 8);
	ILI9341_sendData8(_x1 & 0xFF);
	ILI9341_sendData8(_x2 >> 8);
	ILI9341_sendData8(_x2 & 0xFF);

	ILI9341_sendCommand8(ILI9341_PAGE_ADDR);
	ILI9341_sendData8(_y1 >> 8);
	ILI9341_sendData8(_y1 & 0xFF);
	ILI9341_sendData8(_y2 >> 8);
	ILI9341_sendData8(_y2 & 0xFF);
	ILI9341_sendCommand8(ILI9341_GRAM);
}

void ILI9341_printBitmap(uint8_t *_data) {
	if (rotationNum == 1 || rotationNum == 3) {
		ILI9341_setRect(0, 0, ILI9341_WIDTH - 1, ILI9341_HEIGHT - 1);
	} else if (rotationNum == 2 || rotationNum == 4) {
		ILI9341_setRect(0, 0, ILI9341_HEIGHT - 1, ILI9341_WIDTH - 1);
	}

	for (uint32_t i = 0; i < ILI9341_PIXEL_COUNT; i++) {
		ILI9341_sendData16(col8to16[_data[i]]);
	}
}

void ILI9341_printBitmap_split(uint8_t *_data, uint8_t _div) {
	uint16_t pixel_count = 0;
	if (rotationNum == 1 || rotationNum == 3) {
		uint16_t split_width = ILI9341_HEIGHT / ILI9341_SPLIT_NUM;
		pixel_count = ILI9341_WIDTH * split_width;
		ILI9341_setRect(0, (_div * split_width), ILI9341_WIDTH - 1, ((_div + 1) * split_width - 1));
	} else if (rotationNum == 2 || rotationNum == 4) {
		uint16_t split_width = ILI9341_WIDTH / ILI9341_SPLIT_NUM;
		pixel_count = ILI9341_HEIGHT * split_width;
		ILI9341_setRect(0, (_div * split_width), ILI9341_HEIGHT - 1, ((_div + 1) * split_width - 1));
	}

	_data = _data + (pixel_count * _div);

	for (uint32_t i = 0; i < pixel_count; i++) {
		ILI9341_sendData16(col8to16[_data[i]]);
	}
}

const uint16_t col8to16[256] = {0b0000000000000000,
	0b0000000000001010,
	0b0000000000010101,
	0b0000000000011111,
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	0b1111111111110101,
	0b1111111111111111
};
